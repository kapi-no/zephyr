/*
 * Basic Device Tree file for simulated flash entry declaration.
 */

/ {
	sim_flash {
		compatible = "sim-flash";
		label = "FLASH_SIMULATOR";

		#address-cells = <1>;
		#size-cells = <1>;

		flash_sim0: flash_sim@0 {
			compatible = "soc-nv-flash";
			reg = <0x00000000 (256*1024)>;

			erase-block-size = <4096>;
			write-block-size = <4>;
		};
	};
};
